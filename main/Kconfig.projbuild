## main/Kconfig.projbuild
```kconfig
menu "Wi-Fi Credentials"

config WIFI_SSID
    string "Wi-Fi SSID (compile-time fallback)"
    default ""
    help
        Optional compile-time fallback SSID. WiFi credentials stored in NVS
        (via SoftAP provisioning) take priority over this value.
        Leave empty to always use SoftAP provisioning.

config WIFI_PASSWORD
    string "Wi-Fi Password (compile-time fallback)"
    default ""
    help
        Optional compile-time fallback password. WiFi credentials stored in NVS
        (via SoftAP provisioning) take priority over this value.

endmenu

menu "Tang Server"

config NUM_EXCHANGE_KEYS
    int "Number of active exchange keys"
    default 3
    range 1 16
    help
        Number of active exchange key generations to keep.
        Keys are stored in a ring buffer and rotated.
        Higher values allow clients with older keys to
        still recover, at the cost of more NVS storage.

endmenu
```

## sdkconfig.defaults
```kconfig
# Target Configuration
CONFIG_IDF_TARGET="esp32c6"

# WiFi Configuration
CONFIG_WIFI_SSID="DoNotSetTheRealValueHere"
CONFIG_WIFI_PASSWORD="PutTheRealPassInTheSdkconfigFile"

# TEE (Trusted Execution Environment)
CONFIG_SECURE_ENABLE_TEE=y
CONFIG_SECURE_TEE_ATTESTATION=y
CONFIG_SECURE_TEE_DEBUG_MODE=n
# Enable these on production device
CONFIG_SECURE_TEE_SEC_STG_MODE_RELEASE=y
CONFIG_SECURE_TEE_SEC_STG_EFUSE_HMAC_KEY_ID=2
CONFIG_SECURE_TEE_PBKDF2_EFUSE_HMAC_KEY_ID=3
CONFIG_MBEDTLS_TEE_SEC_STG_ECDSA_SIGN=n


# Custom partition table with TEE support
CONFIG_PARTITION_TABLE_CUSTOM=y
CONFIG_PARTITION_TABLE_CUSTOM_FILENAME="partitions.csv"

# Secure Boot V2
CONFIG_SECURE_BOOT=y
CONFIG_SECURE_BOOT_V2_ENABLED=y
CONFIG_SECURE_BOOT_V2_ALLOW_EFUSE_RD_DIS=y
CONFIG_SECURE_SIGNED_APPS_ECDSA_V2_SCHEME=y
CONFIG_SECURE_BOOT_SIGNING_KEY="secure_boot_signing_key.pem"
CONFIG_PARTITION_TABLE_OFFSET=0x10000

# Flash Encryption
CONFIG_SECURE_FLASH_ENC_ENABLED=y
CONFIG_SECURE_FLASH_ENCRYPTION_MODE_DEVELOPMENT=y

# HTTPS Server
CONFIG_ESP_HTTPS_SERVER_ENABLE=y

# DPA Protection
CONFIG_ESP_CRYPTO_DPA_PROTECTION_LEVEL_MEDIUM=y

# Compiler Optimization (Release Build)
CONFIG_COMPILER_OPTIMIZATION_SIZE=y
CONFIG_OPTIMIZATION_LEVEL_RELEASE=y
```
